## config/west.yml
```yaml
manifest:
  remotes:
    - name: zmkfirmware
      url-base: https://github.com/zmkfirmware
    - name: englmaxi
      url-base: https://github.com/englmaxi
    - name: zzeneg # <-- required for Raw HID module
      url-base: https://github.com/zzeneg
    - name: srwi # <-- required for KeyPeek module
      url-base: https://github.com/srwi
  projects:
    - name: zmk
      remote: zmkfirmware
      revision: v0.3
      import: app/west.yml
    - name: zmk-dongle-display
      remote: englmaxi
      revision: v0.3
    - name: zmk-raw-hid # <-- Raw HID module
      remote: zzeneg
      revision: main
    - name: zmk-keypeek-layer-notifier # <-- KeyPeek module
      remote: srwi
      revision: master
  self:
    path: config
```
